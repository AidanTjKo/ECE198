/*
 * MAX7219.c
 *
 *  Created on: 16 Jan 2023
 *      Author: EDISON NGUNJIRI
 */
#include "stm32f4xx_hal.h"
#include "MAX7219.h"
#define CHAR_MAX 38
uint8_t decode[2];
extern SPI_HandleTypeDef hspi1;
uint8_t data[2];
uint8_t shutdown[2];

uint8_t i=0;
uint8_t ON=0xFF;
uint8_t OFF=0x00;

const uint8_t InitCommands[10][2]={
		{0x09,0x00},
		{0x0A,0x00},
		{0x0B,0x07},
		{0x0C,0x01},
		{0x0F,0x00}
};
uint8_t LETTERS[CHAR_MAX][8]={
		{0x00,0x08,0x14,0x14,0x14,0x14,0x08,0x00},/*0*/
		{0x00,0x1C,0x08,0x08,0x08,0x0C,0x08,0x00},/*1*/
		{0x00,0x3C,0x04,0x18,0x20,0x20,0x1C,0x00},/*2*/
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		{0xFF,0xE7,0xC3,0xC1,0x81,0x81,0xCB,0xFF},/*HEART OFF*/
};


void MAX72_Init_F(void)
{
	uint8_t i=0;
	for(i=0;i<5;i++)
	{
		shutdown[0]=InitCommands[i][0];
		shutdown[1]=InitCommands[i][1];
		HAL_GPIO_WritePin(GPIOB, GPIO_PIN_6, GPIO_PIN_RESET);
		HAL_SPI_Transmit(&hspi1,shutdown,2, 1000);
		HAL_Delay(10);
		HAL_GPIO_WritePin(GPIOB,GPIO_PIN_6, GPIO_PIN_SET);
		HAL_Delay(10);
		HAL_GPIO_WritePin(GPIOB,GPIO_PIN_6, GPIO_PIN_RESET);
		HAL_Delay(10);
	}
}

void Print_Alphabet(void)
{
	for(int i=0;i<=CHAR_MAX;i++)
	{
		for(int k=1;k<=8;k++)
		{
			shutdown[0]=k;
			shutdown[1]=LETTERS[i-1][k-1];
			HAL_GPIO_WritePin(GPIOB, GPIO_PIN_6, GPIO_PIN_RESET);
			HAL_SPI_Transmit(&hspi1,shutdown,2, HAL_MAX_DELAY);
			HAL_GPIO_WritePin(GPIOB,GPIO_PIN_6, GPIO_PIN_SET);
		}
		HAL_Delay(1000);
	}
}


void Print_Dot(uint8_t row, uint8_t col)
{
    if (row < 1 || row > 8 || col < 0 || col > 7)
    {
        return; // Invalid row or column, do nothing
    }

    for (uint8_t r = 1; r <= 8; r++)
    {
        shutdown[0] = r; // Set the row address
        if (r == row)
        {
            // Light up only the specified dot
            shutdown[1] = 1 << (8 - col);
        }
        else
        {
            // Clear all other rows
            shutdown[1] = 0x00;
        }

        // Transmit the data to the MAX7219
        HAL_GPIO_WritePin(GPIOB, GPIO_PIN_6, GPIO_PIN_RESET);
        HAL_SPI_Transmit(&hspi1, shutdown, 2, HAL_MAX_DELAY);
        HAL_GPIO_WritePin(GPIOB, GPIO_PIN_6, GPIO_PIN_SET);
    }
}


uint8_t matrix_state[8] = {0}; // Holds the current state of the 8 rows

void Set_Dot(uint8_t row, uint8_t col)
{
    if (row < 1 || row > 8 || col < 0 || col > 7)
    {
        return; // Invalid row or column, do nothing
    }

    matrix_state[row - 1] |= (1 << (8 - col)); // Set the bit for the specified column
}

void Clear_Dot(uint8_t row, uint8_t col)
{
    if (row < 1 || row > 8 || col < 0 || col > 7)
    {
        return; // Invalid row or column, do nothing
    }

    matrix_state[row - 1] &= ~(1 << (8 - col)); // Clear the bit for the specified column
}

void Update_Matrix()
{
    for (uint8_t r = 1; r <= 8; r++)
    {
        shutdown[0] = r;                   // Set the row address
        shutdown[1] = matrix_state[r - 1]; // Set the data for that row

        // Transmit the data to the MAX7219
        HAL_GPIO_WritePin(GPIOB, GPIO_PIN_6, GPIO_PIN_RESET);
        HAL_SPI_Transmit(&hspi1, shutdown, 2, HAL_MAX_DELAY);
        HAL_GPIO_WritePin(GPIOB, GPIO_PIN_6, GPIO_PIN_SET);
    }
}


void Clear_Matrix()
{
    // Clear the matrix_state array
    for (uint8_t i = 0; i < 8; i++)
    {
        matrix_state[i] = 0x00; // Set all rows to 0 (all LEDs off)
    }

    // Update the MAX7219 to reflect the cleared state
    for (uint8_t r = 1; r <= 8; r++)
    {
        shutdown[0] = r;        // Set the row address
        shutdown[1] = 0x00;     // Turn off all columns in the row

        HAL_GPIO_WritePin(GPIOB, GPIO_PIN_6, GPIO_PIN_RESET);
        HAL_SPI_Transmit(&hspi1, shutdown, 2, HAL_MAX_DELAY);
        HAL_GPIO_WritePin(GPIOB, GPIO_PIN_6, GPIO_PIN_SET);
    }
}


